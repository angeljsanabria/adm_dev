# file: tp1_ej1.ioc
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Mcu.Family=STM32L4
Mcu.Name=STM32L4R5Z(G-I)Tx
Mcu.Package=LQFP144
NVIC.PriorityGroup=NVIC_PRIORITYGROUP_4
ProjectManager.HeapSize=0x200
ProjectManager.StackSize=0x400
ProjectManager.TargetToolchain=STM32CubeIDE
RCC.HSE_VALUE=8000000
RCC.HSI48_VALUE=48000000
RCC.HSI_VALUE=16000000
RCC.LSE_VALUE=32768
RCC.MSI_VALUE=4000000
RCC.VCOOutputFreq_Value=32000000
board=custom

// file: Core/Src/main.c
/* USER CODE BEGIN Header */
/**
  ******************************************************************************
  * @file           : main.c
  * @brief          : Main program body
  ******************************************************************************
  * @attention
  *
  * Copyright (c) 2026 STMicroelectronics.
  * All rights reserved.
  *
  * This software is licensed under terms that can be found in the LICENSE file
  * in the root directory of this software component.
  * If no LICENSE file comes with this software, it is provided AS-IS.
  *
  ******************************************************************************
  */
/* USER CODE END Header */
#include "main.h"

/* USER CODE BEGIN Includes */
#include "functions.h"
#include "datos_prueba_ge2.h"
/* USER CODE END Includes */

void SystemClock_Config(void);

int main(void)
{

  /* USER CODE BEGIN 1 */
	/* ----------- Ejercicio 4 ----------- */
	uint16_t buffer_par[LONGITUD_EJ4_PAR] = {0};
	uint16_t buffer_impar[LONGITUD_EJ4_IMPAR] = {0};
	int32_t  vectorIn_max[LONGITUD_EJ3] = {0};
	int32_t Signal_HF_test[LONGITUD_EJ2_IN] = {0};
	int32_t Signal_LF_test[4] = {0};     // 36/3 = 12 muestras
	uint16_t muestras = LONGITUD_EJ2_IN;
	uint16_t muestrasRed = 9;

	for (uint8_t i = 0; i < LONGITUD_EJ4_PAR; i++)		buffer_par[i] = buffer_ej4_in[i];
	for (uint8_t i = 0; i < LONGITUD_EJ4_IMPAR; i++)	buffer_impar[i] = buffer_ej4_in_b[i];
	for (uint8_t i = 0; i < LONGITUD_EJ3; i++)			vectorIn_max[i] = vectorIn_ej3[i];
	for (uint8_t i = 0; i < LONGITUD_EJ2_IN; i++)		Signal_HF_test[i] = Signal_HF[i];

	asm_invertir((uint16_t *)buffer_par, (uint16_t)LONGITUD_EJ4_PAR);
	asm_invertir((uint16_t *)buffer_impar, (uint16_t)LONGITUD_EJ4_IMPAR);

	uint32_t indice;
	indice = asm_max((int32_t *)vectorIn_max, LONGITUD_EJ3);

	vectorIn_max[0] = (int32_t)(vectorIn_max[indice] + 38);
	(void)indice;

	indice = asm_max((int32_t *)vectorIn_max, LONGITUD_EJ3);
	(void)indice;

	vectorIn_max[LONGITUD_EJ3-1] = (int32_t)(vectorIn_max[indice] + 38);

	indice = asm_max((int32_t *)vectorIn_max, LONGITUD_EJ3);
	(void)indice;

	asm_downSample((int32_t *)Signal_HF_test,(int32_t*)Signal_LF_test, muestras, muestrasRed);
  /* USER CODE END 1 */

  /* MCU Configuration--------------------------------------------------------*/

  /* Reset of all peripherals, Initializes the Flash interface and the Systick. */
  HAL_Init();

  /* Configure the system clock */
  SystemClock_Config();

  /* Initialize all configured peripherals */

  /* Infinite loop */
  while (1)
  {
//	  productoEscalar32(vec, vecOut1, lon, esc);
//	  asm_productoEscalar32(vec, vecOut1, lon, esc);
  }
}

void SystemClock_Config(void)
{
  RCC_OscInitTypeDef RCC_OscInitStruct = {0};
  RCC_ClkInitTypeDef RCC_ClkInitStruct = {0};

  /** Configure the main internal regulator output voltage
  */
  if (HAL_PWREx_ControlVoltageScaling(PWR_REGULATOR_VOLTAGE_SCALE1) != HAL_OK)
  {
    Error_Handler();
  }

  /** Initializes the RCC Oscillators according to the specified parameters
  * in the RCC_OscInitTypeDef structure.
  */
  RCC_OscInitStruct.OscillatorType = RCC_OSCILLATORTYPE_MSI;
  RCC_OscInitStruct.MSIState = RCC_MSI_ON;
  RCC_OscInitStruct.MSICalibrationValue = 0;
  RCC_OscInitStruct.MSIClockRange = RCC_MSIRANGE_6;
  RCC_OscInitStruct.PLL.PLLState = RCC_PLL_NONE;
  if (HAL_RCC_OscConfig(&RCC_OscInitStruct) != HAL_OK)
  {
    Error_Handler();
  }

  /** Initializes the CPU, AHB and APB buses clocks
  */
  RCC_ClkInitStruct.ClockType = RCC_CLOCKTYPE_HCLK|RCC_CLOCKTYPE_SYSCLK
                              |RCC_CLOCKTYPE_PCLK1|RCC_CLOCKTYPE_PCLK2;
  RCC_ClkInitStruct.SYSCLKSource = RCC_SYSCLKSOURCE_MSI;
  RCC_ClkInitStruct.AHBCLKDivider = RCC_SYSCLK_DIV1;
  RCC_ClkInitStruct.APB1CLKDivider = RCC_HCLK_DIV1;
  RCC_ClkInitStruct.APB2CLKDivider = RCC_HCLK_DIV1;

  if (HAL_RCC_ClockConfig(&RCC_ClkInitStruct, FLASH_LATENCY_0) != HAL_OK)
  {
    Error_Handler();
  }
}

void Error_Handler(void)
{
  __disable_irq();
  while (1)
  {
  }
}
